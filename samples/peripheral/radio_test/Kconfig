## samples/peripheral/radio_test/Kconfig
```kconfig
#
# Copyright (c) 2020 Nordic Semiconductor
#
# SPDX-License-Identifier: LicenseRef-Nordic-5-Clause
#

mainmenu "Nordic Radio test sample"

config RADIO_TEST_USB
	bool "Radio Test shell over USB CDC ACM class"
	depends on SOC_NRF5340_CPUNET
	select EXPERIMENTAL
	help
	  Selects USB instead of UART as the Radio Test shell transport.
	  For nRF5340, the USB from application core is used as the communication interface.

config RADIO_TEST_POWER_CONTROL_AUTOMATIC
	bool "Automatic power control"
	depends on FEM
	default y
	help
	  Sets the SoC output power and front-end module gain to achieve the requested TX output power.
	  If the exact value cannot be achieved, power is set to closest value that does not exceed the limits
	  If this option is disabled, set the SoC output power and FEM gain with separate commands.

config RADIO_TEST_RX_TIMEOUT
	int "RX packet reception timeout"
	default 10
	help
	  Specifies the time in seconds that the application waits for the first packet to be
	  received in RX mode when a specified number of packets are set to be received.
	  If the timeout is reached before the first packet is received, the radio will be disabled.

config RADIO_TEST_PIN_DEBUG
	bool "Pin debug"
	depends on SOC_COMPATIBLE_NRF54LX
	select NRFX_GPIOTE
	default n
	help
	  Enables toggling of GPIO pins on radio events.
	  This can be useful for debugging to determine when the radio is being used.
	  This feature is currently only supported and tested on nRF54L Series devices.


if RADIO_TEST_PIN_DEBUG

config RADIO_TEST_PIN_DEBUG_RADIO_READY_AND_DISABLED_PIN
	int "Pin toggled upon the events RADIO->EVENTS_READY and RADIO->EVENTS_DISABLED"
	depends on RADIO_TEST_PIN_DEBUG
	default 43 if SOC_COMPATIBLE_NRF54LX
	help
	  Sets the pin number that is set when RADIO->EVENTS_READY triggers and cleared when RADIO->EVENTS_DISABLED triggers, if CONFIG_RADIO_TEST_PIN_DEBUG is enabled.
	  For nRF54L only PORT1 can be used and the default pin number
	  is 43 - 32 = 11.

config RADIO_TEST_PIN_DEBUG_RADIO_ADDRESS_AND_END_PIN
	int "Pin toggled upon the events RADIO->EVENTS_ADDRESS and RADIO->EVENTS_END"
	depends on RADIO_TEST_PIN_DEBUG
	default 44 if SOC_COMPATIBLE_NRF54LX
	help
	  Sets the pin number that is set when RADIO->EVENTS_ADDRESS triggers and cleared when RADIO->EVENTS_END triggers, if CONFIG_RADIO_TEST_PIN_DEBUG is enabled.
	  For nRF54L only PORT1 can be used and the default pin number
	  is 44 - 32 = 12.

endif

source "Kconfig.zephyr"
```
